/dts-v1/;
/plugin/;

/* Apply to the in-memory FIT FDT before Linux boots. Do not install this
 * as a live configfs overlay or pair it with any bit other than gli26c/bit1. */
/ {
	fragment@0 {
		target-path = "/amba";
		__overlay__ {
			#address-cells = <1>;
			#size-cells = <1>;
			dma-owner@40410000 {
				compatible = "guardianloop,z15-filter-dma-owner-v1";
				reg = <0x40410000 0x00010000>,
				      <0x41200000 0x00010000>;
				reg-names = "dma", "control";
				guardianloop,abi-version = <1>;
				status = "okay";
			};
		};
	};
};
